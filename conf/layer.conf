## conf/layer.conf
```bitbake
# We have a conf and classes directory, append to BBPATH
BBPATH .= ":${LAYERDIR}"

BBFILES += "${LAYERDIR}/recipes*/*/*.bb ${LAYERDIR}/recipes*/*/*.bbappend ${LAYERDIR}/images/*.bb"

BBFILE_COLLECTIONS += "meta-berkeley"
BBFILE_PATTERN_meta-berkeley := "^${LAYERDIR}/"
BBFILE_PRIORITY_meta-berkeley = "16"
```
